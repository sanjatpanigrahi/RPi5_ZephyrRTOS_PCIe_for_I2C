## CMakeLists.txt
```
# app/rp1_pcie_i2c/CMakeLists.txt

cmake_minimum_required(VERSION 3.20.0)

find_package(Zephyr REQUIRED HINTS $ENV{ZEPHYR_BASE})
project(rp1_pcie_i2c)

target_sources(app PRIVATE
    src/main.c
    src/rp1_pcie_i2c.c
    src/uart_cmd.c
)

target_include_directories(app PRIVATE include)
```

## prj.conf
```kconfig
# --- Core kernel/RTOS ---
CONFIG_MAIN_STACK_SIZE=4096
CONFIG_SYSTEM_WORKQUEUE_STACK_SIZE=4096

# --- Logging ---
CONFIG_LOG=y
CONFIG_LOG_MODE_IMMEDIATE=y
CONFIG_LOG_DEFAULT_LEVEL=3

# --- Console / UART ---
CONFIG_SERIAL=y
CONFIG_CONSOLE=y
CONFIG_UART_CONSOLE=y

# --- PCIe host stack ---
# Root complex support
CONFIG_PCIE=y

# Enable PCIe *controller* drivers (brcmstb driver is selected automatically
# when the brcm,brcmstb-pcie node is present in DTS)
CONFIG_PCIE_CONTROLLER=y

# Optional: MSI support (you can comment this out if it causes issues)
CONFIG_PCIE_MSI=y

# --- I2C framework ---
CONFIG_I2C=y

# Let Zephyr use the default init priority for I2C, it's fine for now.
# If you really want to override it:
# CONFIG_I2C_INIT_PRIORITY=60

# --- Basic debug/sanity ---
CONFIG_ASSERT=y
CONFIG_PRINTK=y
```

## boards/rpi_5.overlay
```dts
/* app/boards/rpi_5.overlay */
 / {
    chosen {
        zephyr,pcie-controller = &pcie2;
    };

    rp1_i2c1: i2c1 {
        compatible = "brcm,rp1-pcie-i2c";
        status = "okay";

        /* Optional (only used by device_get_binding) */
        label = "RP1_I2C1";

        /* IMPORTANT: header pins 3/5 are GPIO2/3 => use RP1 I2C1 */
        rp1-i2c-index = <1>;

        pcie-bus = <0>;
        pcie-device = <0>;
        pcie-function = <0>;
        pcie-bar = <1>;

        clock-frequency = <100000>;  /* start at 100k, later try 400k */
    };
};

&pcie2 {
    status = "okay";
};
```

## src/main.c
```c
#include <zephyr/kernel.h>
#include <zephyr/device.h>
#include <zephyr/devicetree.h>
#include <zephyr/drivers/i2c.h>
#include <zephyr/drivers/uart.h>
#include <zephyr/logging/log.h>
#include <errno.h>
#include <string.h>
#include <stdio.h>

#include "uart_cmd.h"

LOG_MODULE_REGISTER(app, LOG_LEVEL_INF);

#define RP1_I2C_NODE DT_NODELABEL(rp1_i2c1)

#if !DT_NODE_HAS_STATUS(RP1_I2C_NODE, okay)
#error "rp1_i2c1 node is not okay in devicetree (overlay not applied?)"
#endif

static const struct device *const i2c_dev = DEVICE_DT_GET(RP1_I2C_NODE);

/* Console UART (same as Zephyr logs) */
static const struct device *const uart_dev = DEVICE_DT_GET(DT_CHOSEN(zephyr_console));
static uart_cmd_ctx_t uart_ctx;

/* -------------------- TCS3408 basics -------------------- */
#define TCS3408_ADDR      0x39  /* 7-bit */

#define REG_PARTID        0x90
#define REG_REVID         0x91
#define REG_ID            0x92

#define CMD_BIT           0x80

#define REG_ENABLE        0x80
#define REG_ATIME         0x81
#define REG_CFG1          0x83

#define EN_PON            (1u << 0)
#define EN_AEN            (1u << 1)

/* Channel regs (16-bit LE) */
#define REG_CDATA_L       0x94
#define REG_RDATA_L       0x96
#define REG_GDATA_L       0x98
#define REG_BDATA_L       0x9A
#define REG_WDATA_L       0x9C

/* Flicker placeholder; adjust if you know exact address */
#define REG_FLICKER_L     0xA0

/* -------------------- Streaming + cached data -------------------- */
static bool streaming = false;
static bool read_once = false;
static uint32_t ch_mask = UART_CH_ALL;

static uint16_t last_flicker = 0;
static int last_flicker_valid = 0;

static uint16_t last_c = 0, last_r = 0, last_g = 0, last_b = 0, last_w = 0;

/* -------------------- Helpers: robust reg access -------------------- */

static int tcs_write8(const struct device *i2c, uint8_t addr, uint8_t reg, uint8_t val)
{
	uint8_t buf[2] = { reg, val };
	return i2c_write(i2c, buf, sizeof(buf), addr);
}

static int tcs_readn_rs(const struct device *i2c, uint8_t addr, uint8_t reg, uint8_t *buf, size_t n)
{
	/* repeated-start */
	return i2c_write_read(i2c, addr, &reg, 1, buf, n);
}

static int tcs_readn_auto(const struct device *i2c, uint8_t addr, uint8_t reg, uint8_t *buf, size_t n, bool *used_cmd_bit)
{
	int rc = tcs_readn_rs(i2c, addr, reg, buf, n);
	if (rc == 0) {
		if (used_cmd_bit) *used_cmd_bit = false;
		return 0;
	}

	rc = tcs_readn_rs(i2c, addr, (uint8_t)(CMD_BIT | reg), buf, n);
	if (rc == 0) {
		if (used_cmd_bit) *used_cmd_bit = true;
		return 0;
	}

	return rc;
}

static int tcs_write8_auto(const struct device *i2c, uint8_t addr, uint8_t reg, uint8_t val, bool use_cmd_bit)
{
	uint8_t r = use_cmd_bit ? (uint8_t)(CMD_BIT | reg) : reg;
	return tcs_write8(i2c, addr, r, val);
}

static int tcs_read8_auto(const struct device *i2c, uint8_t addr, uint8_t reg, uint8_t *val, bool *used_cmd_bit)
{
	return tcs_readn_auto(i2c, addr, reg, val, 1, used_cmd_bit);
}

static int tcs_read16_auto(const struct device *i2c, uint8_t addr, uint8_t reg_l, uint16_t *out, bool use_cmd_bit)
{
	uint8_t r = use_cmd_bit ? (uint8_t)(CMD_BIT | reg_l) : reg_l;
	uint8_t b[2] = {0};
	int rc = tcs_readn_rs(i2c, addr, r, b, 2);
	if (rc) return rc;
	*out = (uint16_t)b[0] | ((uint16_t)b[1] << 8);
	return 0;
}

/* -------------------- Sensor “validation” -------------------- */

static int tcs_validate_identity(bool *use_cmd_bit_out, uint8_t *partid, uint8_t *revid, uint8_t *id)
{
	bool use_cmd_bit = false;

	uint8_t v = 0;
	int rc = tcs_read8_auto(i2c_dev, TCS3408_ADDR, REG_PARTID, &v, &use_cmd_bit);
	if (rc) return rc;
	*partid = v;

	rc = tcs_read8_auto(i2c_dev, TCS3408_ADDR, REG_REVID, &v, NULL);
	if (rc) return rc;
	*revid = v;

	rc = tcs_read8_auto(i2c_dev, TCS3408_ADDR, REG_ID, &v, NULL);
	if (rc) return rc;
	*id = v;

	*use_cmd_bit_out = use_cmd_bit;

	if ((*partid == 0x00) || (*partid == 0xFF) || (*revid == 0x00) || (*revid == 0xFF)) {
		return -ENODEV;
	}

	return 0;
}

/* -------------------- Minimal start/config -------------------- */

static int tcs_start_measurement(bool use_cmd_bit)
{
	int rc = tcs_write8_auto(i2c_dev, TCS3408_ADDR, REG_ENABLE, EN_PON, use_cmd_bit);
	if (rc) return rc;

	k_msleep(5);

	rc = tcs_write8_auto(i2c_dev, TCS3408_ADDR, REG_ENABLE, EN_PON | EN_AEN, use_cmd_bit);
	if (rc) return rc;

	/* Optional ATIME tweak if you want
	 * rc = tcs_write8_auto(i2c_dev, TCS3408_ADDR, REG_ATIME, 0xDB, use_cmd_bit);
	 * if (rc) return rc;
	 */

	return 0;
}

/* -------------------- AGC (gain) -------------------- */
/* Assumption: REG_CFG1 AGAIN in [1:0], 0..3 => x1,x4,x16,x64 */
static const char *gain_names[] = { "x1", "x4", "x16", "x64" };

static int tcs_get_gain_code(bool use_cmd_bit, uint8_t *gain_code)
{
	uint8_t cfg1 = 0;
	int rc = tcs_read8_auto(i2c_dev, TCS3408_ADDR, REG_CFG1, &cfg1, NULL);
	if (rc) return rc;

	*gain_code = (cfg1 & 0x03u);
	return 0;
}

static int tcs_set_gain_code(bool use_cmd_bit, uint8_t gain_code)
{
	uint8_t cfg1 = 0;
	int rc = tcs_read8_auto(i2c_dev, TCS3408_ADDR, REG_CFG1, &cfg1, NULL);
	if (rc) return rc;

	cfg1 &= ~0x03u;
	cfg1 |= (gain_code & 0x03u);

	return tcs_write8_auto(i2c_dev, TCS3408_ADDR, REG_CFG1, cfg1, use_cmd_bit);
}

#define SAT_THRESH   0xFFF0u
#define LOW_THRESH   0x0100u

static int tcs_agc_step(bool use_cmd_bit,
			uint16_t c, uint16_t r, uint16_t g, uint16_t b, uint16_t w,
			bool *saturated_out, bool *low_out,
			uint8_t *gain_code_inout)
{
	bool sat = (c >= SAT_THRESH) || (r >= SAT_THRESH) || (g >= SAT_THRESH) || (b >= SAT_THRESH) || (w >= SAT_THRESH);
	bool low = (c <= LOW_THRESH) && (r <= LOW_THRESH) && (g <= LOW_THRESH) && (b <= LOW_THRESH) && (w <= LOW_THRESH);

	*saturated_out = sat;
	*low_out = low;

	uint8_t gc = *gain_code_inout;

	if (sat) {
		if (gc > 0) {
			gc--;
			int rc = tcs_set_gain_code(use_cmd_bit, gc);
			if (rc) return rc;
			LOG_WRN("AGC: saturation -> lowering gain to %s (code=%u)", gain_names[gc], gc);
		}
	} else if (low) {
		if (gc < 3) {
			gc++;
			int rc = tcs_set_gain_code(use_cmd_bit, gc);
			if (rc) return rc;
			LOG_INF("AGC: low signal -> raising gain to %s (code=%u)", gain_names[gc], gc);
		}
	}

	*gain_code_inout = gc;
	return 0;
}

/* -------------------- Read channels -------------------- */

static int tcs_read_channels(bool use_cmd_bit,
			     uint16_t *c, uint16_t *r, uint16_t *g, uint16_t *b, uint16_t *w,
			     int *flicker_valid, uint16_t *flicker)
{
	int rc;

	rc = tcs_read16_auto(i2c_dev, TCS3408_ADDR, REG_CDATA_L, c, use_cmd_bit);
	if (rc) return rc;
	rc = tcs_read16_auto(i2c_dev, TCS3408_ADDR, REG_RDATA_L, r, use_cmd_bit);
	if (rc) return rc;
	rc = tcs_read16_auto(i2c_dev, TCS3408_ADDR, REG_GDATA_L, g, use_cmd_bit);
	if (rc) return rc;
	rc = tcs_read16_auto(i2c_dev, TCS3408_ADDR, REG_BDATA_L, b, use_cmd_bit);
	if (rc) return rc;

	rc = tcs_read16_auto(i2c_dev, TCS3408_ADDR, REG_WDATA_L, w, use_cmd_bit);
	if (rc) {
		*w = 0;
	}

	*flicker_valid = 0;
	*flicker = 0;
	rc = tcs_read16_auto(i2c_dev, TCS3408_ADDR, REG_FLICKER_L, flicker, use_cmd_bit);
	if (rc == 0) {
		*flicker_valid = 1;
	}

	return 0;
}

/* -------------------- UART command processing -------------------- */

static void handle_uart_cmd(const uart_cmd_t *cmd)
{
	switch (cmd->type) {
	case UART_CMD_HELP:
		uart_cmd_print_help(&uart_ctx);
		break;

	case UART_CMD_START:
		streaming = true;
		uart_cmd_printf(&uart_ctx, "OK: streaming started");
		break;

	case UART_CMD_STOP:
		streaming = false;
		uart_cmd_printf(&uart_ctx, "OK: streaming stopped");
		break;

	case UART_CMD_STATUS:
		uart_cmd_printf(&uart_ctx, "status: streaming=%d mask=0x%02x",
				streaming ? 1 : 0, ch_mask);
		break;

	case UART_CMD_SET_MASK:
		ch_mask = cmd->mask;
		uart_cmd_printf(&uart_ctx, "OK: mask set to 0x%02x", ch_mask);
		break;

	case UART_CMD_READ_ONCE:
		read_once = true;
		uart_cmd_printf(&uart_ctx, "OK: read once requested");
		break;

	case UART_CMD_PRINT_FLICKER:
		if (last_flicker_valid) {
			uart_cmd_printf(&uart_ctx, "flicker=%u", last_flicker);
		} else {
			uart_cmd_printf(&uart_ctx, "flicker=N/A (not read yet or reg not supported)");
		}
		break;

	default:
		/* ignore */
		break;
	}
}

static void uart_poll_commands(void)
{
	uart_cmd_t cmd;
	while (uart_cmd_get(&uart_ctx, &cmd, K_NO_WAIT) == 0) {
		handle_uart_cmd(&cmd);
	}
}

/* Print sample based on current ch_mask */
static void print_sample(bool sat, bool low, uint8_t gain_code,
			 uint16_t c, uint16_t r, uint16_t g, uint16_t b, uint16_t w,
			 int flicker_valid, uint16_t flicker)
{
	char line[256];
	int n = 0;

	n += snprintk(line + n, sizeof(line) - n, "gain=%s", gain_names[gain_code]);
	if (sat) n += snprintk(line + n, sizeof(line) - n, " [SAT]");
	if (low) n += snprintk(line + n, sizeof(line) - n, " [LOW]");

	if (ch_mask & UART_CH_CLEAR)   n += snprintk(line + n, sizeof(line) - n, " C=%u", c);
	if (ch_mask & UART_CH_RED)     n += snprintk(line + n, sizeof(line) - n, " R=%u", r);
	if (ch_mask & UART_CH_GREEN)   n += snprintk(line + n, sizeof(line) - n, " G=%u", g);
	if (ch_mask & UART_CH_BLUE)    n += snprintk(line + n, sizeof(line) - n, " B=%u", b);
	if (ch_mask & UART_CH_WIDE)    n += snprintk(line + n, sizeof(line) - n, " W=%u", w);

	if (ch_mask & UART_CH_FLICKER) {
		if (flicker_valid) {
			n += snprintk(line + n, sizeof(line) - n, " F=%u", flicker);
		} else {
			n += snprintk(line + n, sizeof(line) - n, " F=N/A");
		}
	}

	uart_cmd_printf(&uart_ctx, "%s", line);
}

/* -------------------- main -------------------- */

int main(void)
{
	LOG_INF("RP1 PCIe+I2C TCS3408 validate + AGC + UART CLI starting...");

	if (!device_is_ready(i2c_dev)) {
		LOG_ERR("RP1 I2C device not ready");
		return 0;
	}
	LOG_INF("Got I2C device: %s", i2c_dev->name);

	if (!device_is_ready(uart_dev)) {
		LOG_ERR("Console UART not ready");
		return 0;
	}

	int rc = uart_cmd_init(&uart_ctx, uart_dev);
	if (rc) {
		LOG_ERR("uart_cmd_init failed: %d", rc);
		return 0;
	}
	uart_cmd_print_help(&uart_ctx);

	bool use_cmd_bit = false;
	uint8_t partid = 0, revid = 0, id = 0;

	rc = tcs_validate_identity(&use_cmd_bit, &partid, &revid, &id);
	if (rc == -ENODEV) {
		uart_cmd_printf(&uart_ctx,
				"TCS3408 validation failed: PARTID/REVID look invalid (PARTID=0x%02x REVID=0x%02x)",
				partid, revid);
		return 0;
	}
	if (rc) {
		uart_cmd_printf(&uart_ctx, "TCS3408 validation read failed: %d", rc);
		return 0;
	}

	uart_cmd_printf(&uart_ctx, "TCS3408 detected: PARTID=0x%02x REVID=0x%02x ID=0x%02x (cmd_bit=%s)",
			partid, revid, id, use_cmd_bit ? "YES" : "NO");

	rc = tcs_start_measurement(use_cmd_bit);
	if (rc) {
		uart_cmd_printf(&uart_ctx, "TCS3408 start failed: %d", rc);
		return 0;
	}

	/* Initialize gain */
	uint8_t gain_code = 1;
	(void)tcs_set_gain_code(use_cmd_bit, gain_code);
	(void)tcs_get_gain_code(use_cmd_bit, &gain_code);
	uart_cmd_printf(&uart_ctx, "Initial gain: %s (code=%u)", gain_names[gain_code], gain_code);

	/* Default: not streaming until 'start' */
	streaming = false;
	read_once = false;
	ch_mask = UART_CH_ALL;

	const int sample_period_ms = 200;

	while (1) {
		/* process UART commands */
		uart_poll_commands();

		/* Decide if we should take a sample */
		bool do_sample = streaming || read_once;

		if (do_sample) {
			uint16_t c = 0, rch = 0, gch = 0, bch = 0, w = 0;
			int flicker_valid = 0;
			uint16_t flicker = 0;

			rc = tcs_read_channels(use_cmd_bit, &c, &rch, &gch, &bch, &w, &flicker_valid, &flicker);
			if (rc) {
				uart_cmd_printf(&uart_ctx, "Read channels failed: %d", rc);
				k_msleep(50);
				continue;
			}

			/* cache last values */
			last_c = c; last_r = rch; last_g = gch; last_b = bch; last_w = w;
			if (flicker_valid) {
				last_flicker_valid = 1;
				last_flicker = flicker;
			}

			bool sat = false, low = false;
			rc = tcs_agc_step(use_cmd_bit, c, rch, gch, bch, w, &sat, &low, &gain_code);
			if (rc) {
				uart_cmd_printf(&uart_ctx, "AGC step failed: %d", rc);
			}

			print_sample(sat, low, gain_code, c, rch, gch, bch, w, flicker_valid, flicker);

			/* single-shot consumed */
			read_once = false;

			/* throttle */
			k_msleep(sample_period_ms);
		} else {
			/* idle */
			k_msleep(20);
		}
	}

	return 0;
}
```

## include/uart_cmd.h
```c
#pragma once

#include <zephyr/kernel.h>
#include <zephyr/device.h>
#include <stdint.h>
#include <stdbool.h>

#ifdef __cplusplus
extern "C" {
#endif

/* Channel mask bits (use whatever you already print) */
#define UART_CH_CLEAR   (1u << 0)
#define UART_CH_RED     (1u << 1)
#define UART_CH_GREEN   (1u << 2)
#define UART_CH_BLUE    (1u << 3)
#define UART_CH_WIDE    (1u << 4)
#define UART_CH_FLICKER (1u << 5)

#define UART_CH_ALL (UART_CH_CLEAR | UART_CH_RED | UART_CH_GREEN | UART_CH_BLUE | UART_CH_WIDE | UART_CH_FLICKER)

typedef enum {
	UART_CMD_NONE = 0,
	UART_CMD_HELP,
	UART_CMD_START,
	UART_CMD_STOP,
	UART_CMD_STATUS,
	UART_CMD_SET_MASK,     /* cmd.mask valid */
	UART_CMD_READ_ONCE,    /* request a single sample print */
	UART_CMD_PRINT_FLICKER /* print last flicker value */
} uart_cmd_type_t;

typedef struct {
	uart_cmd_type_t type;
	uint32_t mask;   /* valid for UART_CMD_SET_MASK */
} uart_cmd_t;

typedef struct {
	const struct device *uart;

	/* Shared TX mutex (so main + RX thread don’t interleave bytes too badly) */
	struct k_mutex tx_lock;

	/* Command queue */
	struct k_msgq *cmd_q;
} uart_cmd_ctx_t;

/**
 * Initialize UART command module and start RX thread.
 *
 * @param ctx      module context
 * @param uart_dev UART device to use (typically DT_CHOSEN(zephyr_console))
 * @return 0 on success
 */
int uart_cmd_init(uart_cmd_ctx_t *ctx, const struct device *uart_dev);

/**
 * Get next parsed command (non-blocking or blocking depending on timeout).
 *
 * @param ctx
 * @param out
 * @param timeout  e.g. K_NO_WAIT, K_MSEC(100), K_FOREVER
 * @return 0 if a command was returned, -EAGAIN if none (when non-blocking), other <0 on error
 */
int uart_cmd_get(uart_cmd_ctx_t *ctx, uart_cmd_t *out, k_timeout_t timeout);

/**
 * Print to UART (thread-safe-ish).
 */
void uart_cmd_printf(uart_cmd_ctx_t *ctx, const char *fmt, ...);

/**
 * Print help menu.
 */
void uart_cmd_print_help(uart_cmd_ctx_t *ctx);

#ifdef __cplusplus
}
#endif
```

## src/rp1_pcie_i2c.c
```c
/*
 * RP1 PCIe I2C (DW_apb_i2c) for Raspberry Pi 5 Zephyr rpi_5 (bcm2712)
 *
 * - Enumerates RP1 at BDF from DT (defaults 00:00.0)
 * - Uses BAR1 as RP1 peripheral window (auto-assigns if BAR1 is 0)
 * - Maps BAR1 with device_map()
 * - Selects I2C instance via DT property rp1-i2c-index (default = 1 for GPIO2/3 header)
 * - Configures RP1 GPIO2/3 pads + mux for I2C1 (FUNCSEL a3)
 *
 * NOTE: Polling-only bring-up (no interrupts yet).
 *
 * FIXES INCLUDED:
 * - Correct handling of repeated-start / multi-message transfers (i2c_write_read)
 *   by:
 *     * NOT waiting for STOP when msg->stop=0
 *     * Issuing RESTART on the first byte/command of the next message
 */

#include <zephyr/kernel.h>
#include <zephyr/device.h>
#include <zephyr/drivers/i2c.h>
#include <zephyr/drivers/pcie/pcie.h>
#include <zephyr/sys/device_mmio.h>
#include <zephyr/sys/sys_io.h>
#include <zephyr/sys/util.h>
#include <zephyr/logging/log.h>
#include <errno.h>

LOG_MODULE_REGISTER(rp1_pcie_i2c, LOG_LEVEL_INF);

#define DT_DRV_COMPAT brcm_rp1_pcie_i2c

/* --------------------------- RP1 address map --------------------------- */
#define RP1_PERIPH_BASE               0x40000000ULL
#define RP1_I2C_BASE(i)               (0x40070000ULL + ((uint64_t)(i) * 0x4000ULL))
#define RP1_I2C_OFFSET_IN_PERIPH(i)   (RP1_I2C_BASE(i) - RP1_PERIPH_BASE)

/* RP1 GPIO/pads blocks live inside BAR1 peripheral window */
#define RP1_IO_BANK0_BASE             0x400D0000ULL
#define RP1_PADS_BANK0_BASE           0x400F0000ULL
#define RP1_IO_BANK0_OFF              (RP1_IO_BANK0_BASE - RP1_PERIPH_BASE)
#define RP1_PADS_BANK0_OFF            (RP1_PADS_BANK0_BASE - RP1_PERIPH_BASE)

/* Header pins 3/5 are GPIO2/3 (SDA/SCL). On RP1 these are I2C1 on FUNCSEL=a3. */
#define RP1_HDR_SDA_GPIO              2
#define RP1_HDR_SCL_GPIO              3
#define RP1_FUNCSEL_A3                3U

/* IO_BANK0 GPIOx_CTRL: base + 0x004 + 8*x */
#define IO_BANK0_GPIO_CTRL_OFF(gpio)  (RP1_IO_BANK0_OFF + 0x004U + ((gpio) * 8U))

/* PADS_BANK0: VOLTAGE_SELECT at +0x000, GPIOx pad at +0x004 + 4*x */
#define PADS_VOLTAGE_SELECT_OFF       (RP1_PADS_BANK0_OFF + 0x000U)
#define PADS_GPIO_OFF(gpio)           (RP1_PADS_BANK0_OFF + 0x004U + ((gpio) * 4U))

/* PADS bits: OD[7], IE[6], DRIVE[5:4], PUE[3], PDE[2], SCHMITT[1], SLEWFAST[0] */
#define PADS_OD                       BIT(7)
#define PADS_IE                       BIT(6)
#define PADS_PUE                      BIT(3)
#define PADS_PDE                      BIT(2)
#define PADS_SCHMITT                  BIT(1)
#define PADS_SLEWFAST                 BIT(0)

/* -------------------------- PCI config offsets -------------------------- */
#define PCI_CFG_VENDOR_DEVICE         0x00U
#define PCI_CFG_CMD_STATUS            0x04U
#define PCI_CFG_BAR0                  0x10U

static inline uint32_t cfg_read32(pcie_bdf_t bdf, uint32_t byte_off)
{
	/* pcie_conf_read takes DWORD index */
	return pcie_conf_read(bdf, (unsigned int)(byte_off >> 2));
}

static inline void cfg_write32(pcie_bdf_t bdf, uint32_t byte_off, uint32_t val)
{
	/* pcie_conf_write returns void */
	pcie_conf_write(bdf, (unsigned int)(byte_off >> 2), val);
}

static inline uint32_t pci_bar_raw(pcie_bdf_t bdf, uint8_t bar_index)
{
	return cfg_read32(bdf, PCI_CFG_BAR0 + (bar_index * 4U));
}

static inline uint32_t pci_bar_bus_addr32(uint32_t bar_raw)
{
	return (bar_raw & ~0xFULL);
}

static inline uint16_t pci_cmd_read(pcie_bdf_t bdf)
{
	return (uint16_t)(cfg_read32(bdf, PCI_CFG_CMD_STATUS) & 0xFFFFU);
}

static inline void pci_cmd_write(pcie_bdf_t bdf, uint16_t cmd)
{
	uint32_t cs = cfg_read32(bdf, PCI_CFG_CMD_STATUS);
	cfg_write32(bdf, PCI_CFG_CMD_STATUS, (cs & 0xFFFF0000U) | cmd);
}

#define PCI_CMD_MEM                   BIT(1)

/* ------------------------- DW_apb_i2c registers ------------------------- */
#define IC_CON                        0x00
#define IC_TAR                        0x04
#define IC_DATA_CMD                   0x10
#define IC_SS_SCL_HCNT                0x14
#define IC_SS_SCL_LCNT                0x18
#define IC_FS_SCL_HCNT                0x1C
#define IC_FS_SCL_LCNT                0x20
#define IC_INTR_MASK                  0x30
#define IC_RAW_INTR_STAT              0x34
#define IC_RX_TL                      0x38
#define IC_TX_TL                      0x3C
#define IC_CLR_INTR                   0x40
#define IC_CLR_TX_ABRT                0x54
#define IC_CLR_STOP_DET               0x60
#define IC_ENABLE                     0x6C
#define IC_STATUS                     0x70
#define IC_TXFLR                      0x74
#define IC_RXFLR                      0x78
#define IC_TX_ABRT_SOURCE             0x80
#define IC_ENABLE_STATUS              0x9C

#define IC_CON_MASTER_MODE            BIT(0)
#define IC_CON_SPEED_SHIFT            1
#define IC_CON_SPEED_SS               (0x1U << IC_CON_SPEED_SHIFT)
#define IC_CON_SPEED_FS               (0x2U << IC_CON_SPEED_SHIFT)
#define IC_CON_RESTART_EN             BIT(5)
#define IC_CON_SLAVE_DISABLE          BIT(6)

/* IC_DATA_CMD bits */
#define IC_DATA_CMD_CMD_READ          BIT(8)
#define IC_DATA_CMD_STOP              BIT(9)
#define IC_DATA_CMD_RESTART           BIT(10)

#define INTR_TX_ABRT                  BIT(6)
#define INTR_STOP_DET                 BIT(9)

/* IC_STATUS bits (subset) */
#define IC_STATUS_TFE                 BIT(2)  /* TX FIFO empty */
#define IC_STATUS_ACTIVITY            BIT(0)  /* activity (not always reliable, but useful) */

/* ------------------------------ MMIO helpers ------------------------------ */
static inline uint32_t reg_read32(uintptr_t base, uint32_t off)
{
	return sys_read32(base + off);
}

static inline void reg_write32(uintptr_t base, uint32_t off, uint32_t val)
{
	sys_write32(val, base + off);
}

/* ------------------------------ Driver data ------------------------------ */
struct rp1_pcie_i2c_config {
	uint8_t bus;
	uint8_t dev;
	uint8_t fun;
	uint8_t bar;              /* expect 1 */
	uint8_t rp1_i2c_index;    /* default 1 for header GPIO2/3 */
	uint32_t bitrate;
};

struct rp1_pcie_i2c_data {
	mm_reg_t bar_virt_storage;
	uintptr_t bar_virt;
	uint64_t bar_phys;
	uint32_t bar_size;

	uintptr_t regs;           /* selected I2C regs */
	struct k_mutex lock;
};

/* -------------------- PCI BAR sizing (32-bit mem BAR) -------------------- */
static int pci_size_mem32_bar(pcie_bdf_t bdf, uint8_t bar, uint32_t orig_lo,
			      uint32_t *size_out, uint32_t *mask_out)
{
	/* IO BAR? */
	if (orig_lo & 0x1U) {
		return -ENOTSUP;
	}

	const uint32_t off = PCI_CFG_BAR0 + (bar * 4U);

	/* Probe by writing all-ones */
	cfg_write32(bdf, off, 0xFFFFFFFFu);
	uint32_t mask = cfg_read32(bdf, off);
	/* Restore */
	cfg_write32(bdf, off, orig_lo);

	uint32_t mask_addr = (mask & ~0xFULL);
	if (mask_addr == 0U || mask_addr == 0xFFFFFFFFu) {
		return -EINVAL;
	}

	uint32_t size = (~mask_addr) + 1U;
	if ((size & (size - 1U)) != 0U) {
		return -EINVAL;
	}

	*size_out = size;
	if (mask_out) {
		*mask_out = mask_addr;
	}
	return 0;
}

/* ---------------------- RP1 GPIO2/3 pin configuration --------------------- */
static void rp1_configure_header_i2c_pins(struct rp1_pcie_i2c_data *d)
{
	/* 3.3V select (bit0=0) */
	uint32_t vs = reg_read32(d->bar_virt, (uint32_t)PADS_VOLTAGE_SELECT_OFF);
	LOG_INF("PADS VOLTAGE_SELECT before=0x%08x", vs);
	vs &= ~BIT(0);
	reg_write32(d->bar_virt, (uint32_t)PADS_VOLTAGE_SELECT_OFF, vs);
	LOG_INF("PADS VOLTAGE_SELECT after =0x%08x",
		reg_read32(d->bar_virt, (uint32_t)PADS_VOLTAGE_SELECT_OFF));

	/* Pads: input enable, pull-up enable, schmitt enable, slew limited, OD off */
	const int gpios[2] = { RP1_HDR_SDA_GPIO, RP1_HDR_SCL_GPIO };
	for (int i = 0; i < 2; i++) {
		int gpio = gpios[i];
		uint32_t off = (uint32_t)PADS_GPIO_OFF(gpio);
		uint32_t p = reg_read32(d->bar_virt, off);
		LOG_INF("PADS GPIO%d before=0x%08x", gpio, p);

		p &= ~PADS_OD;        /* OD off (I2C peripheral drives open-drain) */
		p |= PADS_IE;
		p |= PADS_PUE;
		p &= ~PADS_PDE;
		p |= PADS_SCHMITT;
		p &= ~PADS_SLEWFAST;

		reg_write32(d->bar_virt, off, p);
		LOG_INF("PADS GPIO%d after =0x%08x", gpio, reg_read32(d->bar_virt, off));
	}

	/* IO_BANK0 mux: FUNCSEL=a3, overrides cleared to 0 */
	for (int i = 0; i < 2; i++) {
		int gpio = gpios[i];
		uint32_t off = (uint32_t)IO_BANK0_GPIO_CTRL_OFF(gpio);
		uint32_t c = reg_read32(d->bar_virt, off);
		LOG_INF("GPIO%d_CTRL before=0x%08x", gpio, c);

		/* FUNCSEL [4:0] */
		c &= ~0x1FU;
		/* OUTOVER [13:12], OEOVER [15:14], INOVER [17:16] -> 0 */
		c &= ~((3U << 12) | (3U << 14) | (3U << 16));

		c |= RP1_FUNCSEL_A3;

		reg_write32(d->bar_virt, off, c);
		LOG_INF("GPIO%d_CTRL after =0x%08x", gpio, reg_read32(d->bar_virt, off));
	}

	LOG_INF("Pinmux set: GPIO2/3 -> FUNCSEL a3 (I2C1 on header pins 3/5)");
}

/* ------------------------------ DW I2C init ------------------------------ */
static int rp1_dw_disable(uintptr_t regs)
{
	reg_write32(regs, IC_ENABLE, 0);

	int64_t start = k_uptime_get();
	while (reg_read32(regs, IC_ENABLE_STATUS) & 0x1U) {
		if (k_uptime_get() - start > 50) {
			LOG_WRN("HW disable timeout: ENABLE_STATUS=0x%08x",
				reg_read32(regs, IC_ENABLE_STATUS));
			return -ETIMEDOUT;
		}
		k_busy_wait(50);
	}
	return 0;
}

static void rp1_dw_enable(uintptr_t regs)
{
	reg_write32(regs, IC_ENABLE, 1);
	(void)reg_read32(regs, IC_ENABLE_STATUS);
}

static void rp1_dw_set_counts(uintptr_t regs, uint32_t speed_hz)
{
	/* conservative */
	if (speed_hz <= 100000U) {
		reg_write32(regs, IC_SS_SCL_HCNT, 0x01F0);
		reg_write32(regs, IC_SS_SCL_LCNT, 0x0220);
	} else {
		reg_write32(regs, IC_FS_SCL_HCNT, 0x0070);
		reg_write32(regs, IC_FS_SCL_LCNT, 0x00D0);
	}
}

static int rp1_dw_hw_init(uintptr_t regs, uint32_t bitrate_hz)
{
	(void)rp1_dw_disable(regs);

	reg_write32(regs, IC_INTR_MASK, 0);
	reg_write32(regs, IC_RX_TL, 0);
	reg_write32(regs, IC_TX_TL, 0);

	rp1_dw_set_counts(regs, bitrate_hz);

	uint32_t con = IC_CON_MASTER_MODE |
		       IC_CON_RESTART_EN |          /* MUST be set for repeated-start */
		       IC_CON_SLAVE_DISABLE |
		       ((bitrate_hz <= 100000U) ? IC_CON_SPEED_SS : IC_CON_SPEED_FS);
	reg_write32(regs, IC_CON, con);

	(void)reg_read32(regs, IC_CLR_INTR);

	rp1_dw_enable(regs);

	LOG_INF("HW init done: CON=0x%08x ENABLE=0x%08x EN_STAT=0x%08x STATUS=0x%08x",
		reg_read32(regs, IC_CON),
		reg_read32(regs, IC_ENABLE),
		reg_read32(regs, IC_ENABLE_STATUS),
		reg_read32(regs, IC_STATUS));
	return 0;
}

/* --------------------------- Wait helpers (polling) --------------------------- */

static int rp1_dw_wait_stop_or_abort(uintptr_t regs, int32_t timeout_ms)
{
	int64_t deadline = k_uptime_get() + timeout_ms;

	while (k_uptime_get() < deadline) {
		uint32_t raw = reg_read32(regs, IC_RAW_INTR_STAT);

		if (raw & INTR_TX_ABRT) {
			uint32_t src = reg_read32(regs, IC_TX_ABRT_SOURCE);
			(void)reg_read32(regs, IC_CLR_TX_ABRT);
			LOG_ERR("TX_ABRT (SRC=0x%08x) RAW=0x%08x STATUS=0x%08x",
				src, raw, reg_read32(regs, IC_STATUS));
			return -EIO;
		}

		if (raw & INTR_STOP_DET) {
			(void)reg_read32(regs, IC_CLR_STOP_DET);
			return 0;
		}

		k_busy_wait(50);
	}

	LOG_ERR("Timeout waiting STOP (RAW_INTR=0x%08x STATUS=0x%08x TXFLR=%u RXFLR=%u)",
		reg_read32(regs, IC_RAW_INTR_STAT),
		reg_read32(regs, IC_STATUS),
		reg_read32(regs, IC_TXFLR),
		reg_read32(regs, IC_RXFLR));
	return -ETIMEDOUT;
}

/* Used when stop=0: do NOT wait for STOP_DET. Just ensure TX FIFO empties and no abort. */
static int rp1_dw_wait_tx_empty_or_abort(uintptr_t regs, int32_t timeout_ms)
{
	int64_t deadline = k_uptime_get() + timeout_ms;

	while (k_uptime_get() < deadline) {
		uint32_t raw = reg_read32(regs, IC_RAW_INTR_STAT);
		if (raw & INTR_TX_ABRT) {
			uint32_t src = reg_read32(regs, IC_TX_ABRT_SOURCE);
			(void)reg_read32(regs, IC_CLR_TX_ABRT);
			LOG_ERR("TX_ABRT (SRC=0x%08x) RAW=0x%08x STATUS=0x%08x",
				src, raw, reg_read32(regs, IC_STATUS));
			return -EIO;
		}

		uint32_t st = reg_read32(regs, IC_STATUS);
		if (st & IC_STATUS_TFE) {
			return 0;
		}

		k_busy_wait(50);
	}

	LOG_ERR("Timeout waiting TX empty (RAW_INTR=0x%08x STATUS=0x%08x TXFLR=%u RXFLR=%u)",
		reg_read32(regs, IC_RAW_INTR_STAT),
		reg_read32(regs, IC_STATUS),
		reg_read32(regs, IC_TXFLR),
		reg_read32(regs, IC_RXFLR));
	return -ETIMEDOUT;
}

/* --------------------------- Transfer (polling) --------------------------- */
static int rp1_pcie_i2c_transfer(const struct device *dev,
				 struct i2c_msg *msgs,
				 uint8_t num_msgs,
				 uint16_t addr)
{
	struct rp1_pcie_i2c_data *d = dev->data;

	if (!msgs || num_msgs == 0) {
		return -EINVAL;
	}

	k_mutex_lock(&d->lock, K_FOREVER);

	LOG_INF("xfer: addr=0x%02x num_msgs=%u STATUS=0x%08x EN=0x%08x ENS=0x%08x",
		addr, num_msgs,
		reg_read32(d->regs, IC_STATUS),
		reg_read32(d->regs, IC_ENABLE),
		reg_read32(d->regs, IC_ENABLE_STATUS));

	/* Program target (disable around TAR) */
	(void)rp1_dw_disable(d->regs);
	reg_write32(d->regs, IC_TAR, (uint32_t)(addr & 0x7FU));
	(void)reg_read32(d->regs, IC_CLR_INTR);
	rp1_dw_enable(d->regs);

	for (uint8_t mi = 0; mi < num_msgs; mi++) {
		struct i2c_msg *m = &msgs[mi];

		bool is_read = (m->flags & I2C_MSG_READ) != 0U;

		/* STOP: use flag if present; but always STOP on final message for safety */
		bool stop = (m->flags & I2C_MSG_STOP) != 0U;
		if (mi == (num_msgs - 1U)) {
			stop = true;
		}

		/* RESTART: needed when previous message did not end with STOP.
		 * Zephyr i2c_write_read produces msg0 STOP=0 then msg1 with RESTART.
		 * We compute it from previous STOP and also honor I2C_MSG_RESTART if set.
		 */
		bool need_restart = false;
		if (mi > 0U) {
			bool prev_stop = ((msgs[mi - 1U].flags & I2C_MSG_STOP) != 0U);
			if (!prev_stop) {
				need_restart = true;
			}
		}
#ifdef I2C_MSG_RESTART
		if (m->flags & I2C_MSG_RESTART) {
			need_restart = true;
		}
#endif

		LOG_INF("  msg%u: %s len=%u stop=%u restart=%u",
			mi, is_read ? "READ" : "WRITE", m->len,
			stop ? 1 : 0, need_restart ? 1 : 0);

		if (m->len == 0U) {
			/* Nothing to send; still respect stop/restart sequencing.
			 * If stop requested, wait stop; else just continue.
			 */
			int rc = stop ? rp1_dw_wait_stop_or_abort(d->regs, 1000)
				      : rp1_dw_wait_tx_empty_or_abort(d->regs, 1000);
			if (rc) {
				k_mutex_unlock(&d->lock);
				return rc;
			}
			continue;
		}

		if (is_read) {
			/* Issue READ commands.
			 * RESTART is placed on the first read command if required.
			 * STOP is placed on the last read command if stop requested.
			 */
			for (uint32_t i = 0; i < m->len; i++) {
				uint32_t cmd = IC_DATA_CMD_CMD_READ;

				if (need_restart && (i == 0U)) {
					cmd |= IC_DATA_CMD_RESTART;
				}
				if (stop && (i == (m->len - 1U))) {
					cmd |= IC_DATA_CMD_STOP;
				}
				reg_write32(d->regs, IC_DATA_CMD, cmd);
			}

			/* Pull bytes */
			uint32_t got = 0;
			int64_t deadline = k_uptime_get() + 1000;
			while ((got < m->len) && (k_uptime_get() < deadline)) {
				uint32_t rxflr = reg_read32(d->regs, IC_RXFLR);
				while (rxflr && got < m->len) {
					m->buf[got++] = (uint8_t)reg_read32(d->regs, IC_DATA_CMD);
					rxflr--;
				}
				k_busy_wait(50);
			}
			if (got != m->len) {
				LOG_ERR("Timeout waiting RX data (got=%u/%u RXFLR=%u)",
					got, m->len, reg_read32(d->regs, IC_RXFLR));
				k_mutex_unlock(&d->lock);
				return -ETIMEDOUT;
			}

		} else {
			/* WRITE.
			 * RESTART is placed on the first byte if required.
			 * STOP is placed on the last byte if stop requested.
			 */
			for (uint32_t i = 0; i < m->len; i++) {
				uint32_t cmd = (uint32_t)m->buf[i];

				if (need_restart && (i == 0U)) {
					cmd |= IC_DATA_CMD_RESTART;
				}
				if (stop && (i == (m->len - 1U))) {
					cmd |= IC_DATA_CMD_STOP;
				}
				reg_write32(d->regs, IC_DATA_CMD, cmd);
			}
		}

		/* Wait end:
		 * - If STOP requested, wait STOP_DET.
		 * - If STOP not requested, DO NOT wait STOP_DET (would deadlock).
		 *   Just wait TX empty so the next message can proceed with RESTART.
		 */
		int rc = stop ? rp1_dw_wait_stop_or_abort(d->regs, 1000)
			      : rp1_dw_wait_tx_empty_or_abort(d->regs, 1000);
		if (rc) {
			k_mutex_unlock(&d->lock);
			return rc;
		}
	}

	k_mutex_unlock(&d->lock);
	return 0;
}

static int rp1_pcie_i2c_configure(const struct device *dev, uint32_t dev_config)
{
	ARG_UNUSED(dev);
	ARG_UNUSED(dev_config);
	/* already configured in init; keep for API completeness */
	return 0;
}

static const struct i2c_driver_api rp1_pcie_i2c_api = {
	.configure = rp1_pcie_i2c_configure,
	.transfer  = rp1_pcie_i2c_transfer,
};

/* ----------------------------- PCIe init path ----------------------------- */

static int derive_bus_to_phys_bias(pcie_bdf_t bdf, uint64_t *bias_out)
{
	/* Use Zephyr helper for BAR0 phys+size */
	struct pcie_bar bar0;
	if (!pcie_get_mbar(bdf, 0, &bar0)) {
		LOG_ERR("pcie_get_mbar(BAR0) failed; cannot derive bias");
		return -EIO;
	}

	uint32_t bar0_raw = pci_bar_raw(bdf, 0);
	uint32_t bar0_bus = pci_bar_bus_addr32(bar0_raw);
	if (bar0_bus == 0) {
		LOG_ERR("BAR0 bus address is 0; cannot derive bias");
		return -EINVAL;
	}

	uint64_t bias = (uint64_t)bar0.phys_addr - (uint64_t)bar0_bus;

	LOG_INF("Derived bus->phys bias = 0x%llx (BAR0 phys=%p bus=0x%08x size=0x%x)",
		bias, (void *)bar0.phys_addr, bar0_bus, (uint32_t)bar0.size);

	*bias_out = bias;
	return 0;
}

static int assign_mem32_bar_if_zero(pcie_bdf_t bdf, uint8_t bar_index,
				   uint32_t bus_addr, uint32_t bar_size)
{
	uint32_t raw = pci_bar_raw(bdf, bar_index);
	uint32_t cur = pci_bar_bus_addr32(raw);

	if (cur != 0) {
		LOG_INF("BAR%u already assigned: raw=0x%08x bus=0x%08x", bar_index, raw, cur);
		return 0;
	}

	if ((bus_addr & (bar_size - 1U)) != 0U) {
		LOG_ERR("BAR%u assign addr 0x%08x not aligned to size 0x%x",
			bar_index, bus_addr, bar_size);
		return -EINVAL;
	}

	LOG_WRN("Assigning BAR%u: bus_addr=0x%08x size=0x%x (was raw=0x%08x)",
		bar_index, bus_addr, bar_size, raw);

	/* Enable MEM if needed */
	uint16_t cmd = pci_cmd_read(bdf);
	if (!(cmd & PCI_CMD_MEM)) {
		cmd |= PCI_CMD_MEM;
		pci_cmd_write(bdf, cmd);
		LOG_INF("Enabled PCI CMD.MEM (CMD=0x%04x)", cmd);
	}

	cfg_write32(bdf, PCI_CFG_BAR0 + (bar_index * 4U), bus_addr);

	uint32_t new_raw = pci_bar_raw(bdf, bar_index);
	uint32_t new_bus = pci_bar_bus_addr32(new_raw);

	LOG_INF("BAR%u after assign: raw=0x%08x bus=0x%08x", bar_index, new_raw, new_bus);
	return (new_bus == 0) ? -EIO : 0;
}

static int rp1_pcie_i2c_init(const struct device *dev)
{
	const struct rp1_pcie_i2c_config *cfg = dev->config;
	struct rp1_pcie_i2c_data *d = dev->data;

	k_mutex_init(&d->lock);

	pcie_bdf_t bdf = PCIE_BDF(cfg->bus, cfg->dev, cfg->fun);

	uint32_t vd = cfg_read32(bdf, PCI_CFG_VENDOR_DEVICE);
	uint16_t vendor = (uint16_t)(vd & 0xFFFFU);
	uint16_t device = (uint16_t)((vd >> 16) & 0xFFFFU);

	LOG_INF("INIT: BDF=%02x:%02x.%x vendor=%04x device=%04x bar=%u i2c_index=%u",
		cfg->bus, cfg->dev, cfg->fun, vendor, device, cfg->bar, cfg->rp1_i2c_index);

	LOG_INF("PCI CMDSTAT=0x%08x", cfg_read32(bdf, PCI_CFG_CMD_STATUS));

	for (int i = 0; i < 6; i++) {
		LOG_INF("PCI BAR%d raw=0x%08x", i, pci_bar_raw(bdf, i));
	}

	/* Probe BAR size */
	uint32_t bar_raw = pci_bar_raw(bdf, cfg->bar);
	uint32_t want_size = 0, mask = 0;

	LOG_INF("BAR%u orig_lo=0x%08x (mem, 32-bit)", cfg->bar, bar_raw);

	int rc = pci_size_mem32_bar(bdf, cfg->bar, bar_raw, &want_size, &mask);
	if (rc) {
		LOG_ERR("Failed to size BAR%u: %d", cfg->bar, rc);
		return rc;
	}

	LOG_INF("BAR%u sized (32b): addr=0x%x size=0x%x mask_lo=0x%08x",
		cfg->bar, pci_bar_bus_addr32(bar_raw), want_size, mask);

	/* Compute bus->phys bias using BAR0 */
	uint64_t bias = 0;
	rc = derive_bus_to_phys_bias(bdf, &bias);
	if (rc) {
		return rc;
	}

	/* Assign BAR if unassigned (bus addr 0) */
	uint32_t bar_bus = pci_bar_bus_addr32(bar_raw);
	if (bar_bus == 0) {
		/* Place BAR1 after BAR0 window, aligned to BAR size */
		uint32_t bar0_raw = pci_bar_raw(bdf, 0);
		uint32_t bar0_bus = pci_bar_bus_addr32(bar0_raw);
		uint32_t bar0_size = 0, bar0_mask = 0;

		rc = pci_size_mem32_bar(bdf, 0, bar0_raw, &bar0_size, &bar0_mask);
		if (rc) {
			LOG_ERR("Failed to size BAR0 for placement: %d", rc);
			return rc;
		}

		uint32_t candidate = ROUND_UP(bar0_bus + bar0_size, want_size);

		LOG_WRN("BAR%u is 0; assigning candidate bus addr 0x%08x (align=0x%x)",
			cfg->bar, candidate, want_size);

		rc = assign_mem32_bar_if_zero(bdf, cfg->bar, candidate, want_size);
		if (rc) {
			LOG_ERR("Failed to assign BAR%u: %d", cfg->bar, rc);
			return rc;
		}

		bar_raw = pci_bar_raw(bdf, cfg->bar);
		bar_bus = pci_bar_bus_addr32(bar_raw);
	}

	d->bar_phys = bias + (uint64_t)bar_bus;
	d->bar_size = want_size;

	LOG_INF("BAR%u final: bus=0x%08x phys=0x%llx size=0x%x",
		cfg->bar, bar_bus, d->bar_phys, d->bar_size);

	device_map(&d->bar_virt_storage, (uintptr_t)d->bar_phys, d->bar_size, K_MEM_CACHE_NONE);
	d->bar_virt = (uintptr_t)d->bar_virt_storage;

	LOG_INF("Mapped BAR%u phys=0x%llx size=0x%x -> virt=%p",
		cfg->bar, d->bar_phys, d->bar_size, (void *)d->bar_virt);

	/* Pick I2C instance and compute regs VA */
	uint64_t off = RP1_I2C_OFFSET_IN_PERIPH(cfg->rp1_i2c_index);
	if (off + 0x1000ULL > (uint64_t)d->bar_size) {
		LOG_ERR("I2C%u offset 0x%llx out of BAR%u range size=0x%x",
			cfg->rp1_i2c_index, off, cfg->bar, d->bar_size);
		return -ERANGE;
	}

	d->regs = d->bar_virt + (uintptr_t)off;

	LOG_INF("I2C%u regs @ BAR%u+0x%llx => %p",
		cfg->rp1_i2c_index, cfg->bar, off, (void *)d->regs);

	/* Configure header GPIO2/3 for I2C1 only if using I2C1 */
	if (cfg->rp1_i2c_index == 1) {
		rp1_configure_header_i2c_pins(d);
	} else {
		LOG_WRN("Not configuring GPIO2/3 mux because rp1-i2c-index=%u (expected 1 for header)",
			cfg->rp1_i2c_index);
	}

	LOG_INF("Regs pre-init: CON=0x%08x EN=0x%08x ENS=0x%08x STATUS=0x%08x",
		reg_read32(d->regs, IC_CON),
		reg_read32(d->regs, IC_ENABLE),
		reg_read32(d->regs, IC_ENABLE_STATUS),
		reg_read32(d->regs, IC_STATUS));

	rc = rp1_dw_hw_init(d->regs, cfg->bitrate);
	if (rc) {
		LOG_ERR("HW init failed: %d", rc);
		return rc;
	}

	LOG_INF("INIT OK: bitrate=%u", cfg->bitrate);
	return 0;
}

/* ------------------------------ DT glue ---------------------------------- */
/*
 * Optional DT props (all optional; defaults shown):
 *  - pcie-bus = <0>;
 *  - pcie-device = <0>;
 *  - pcie-function = <0>;
 *  - pcie-bar = <1>;
 *  - rp1-i2c-index = <1>;      // IMPORTANT for header GPIO2/3
 *  - clock-frequency = <400000>;
 */
#define RP1_PCIE_I2C_INIT(inst)                                                    \
	static struct rp1_pcie_i2c_data rp1_pcie_i2c_data_##inst;                   \
	static const struct rp1_pcie_i2c_config rp1_pcie_i2c_cfg_##inst = {         \
		.bus = (uint8_t)DT_INST_PROP_OR(inst, pcie_bus, 0),                 \
		.dev = (uint8_t)DT_INST_PROP_OR(inst, pcie_device, 0),              \
		.fun = (uint8_t)DT_INST_PROP_OR(inst, pcie_function, 0),            \
		.bar = (uint8_t)DT_INST_PROP_OR(inst, pcie_bar, 1),                 \
		.rp1_i2c_index = (uint8_t)DT_INST_PROP_OR(inst, rp1_i2c_index, 1),  \
		.bitrate = (uint32_t)DT_INST_PROP_OR(inst, clock_frequency, 100000),\
	};                                                                            \
	DEVICE_DT_INST_DEFINE(inst, rp1_pcie_i2c_init, NULL,                          \
			      &rp1_pcie_i2c_data_##inst,                           \
			      &rp1_pcie_i2c_cfg_##inst, POST_KERNEL,               \
			      CONFIG_I2C_INIT_PRIORITY, &rp1_pcie_i2c_api);

DT_INST_FOREACH_STATUS_OKAY(RP1_PCIE_I2C_INIT)
```

## src/rp1_pcie_i2c.h
```c
/* src/rp1_pcie_i2c.h */

#ifndef RP1_PCIE_I2C_H
#define RP1_PCIE_I2C_H

#include <zephyr/device.h>
#include <zephyr/drivers/i2c.h>
#include <zephyr/drivers/pcie/pcie.h>
#include <zephyr/dt-bindings/pcie/pcie.h>

/* RP1 PCI IDs (as seen in your log) */
#define RP1_PCI_VENDOR_ID 0x1de4
#define RP1_PCI_DEVICE_ID 0x0001

/* On Zephyr RPi5, RP1 only exposes BAR0, 16 KB */
#define RP1_PCI_BAR_INDEX 0

/*
 * IMPORTANT NOTE:
 *
 * In Linux rp1.dtsi, I2C0 is at 0x40070000 within RP1's *internal* map.
 * Here, firmware / PCIe host have already turned that into a BAR window:
 *
 *   BAR0: phys=0x1f00410000 size=0x4000
 *
 * We don't know the exact internal offset behind this window yet, but
 * the only reasonable thing we can do (for now) is to treat BAR0 as
 * the I2C register block directly, i.e. offset 0 inside the BAR.
 *
 * So for RP1_I2C0, we use offset 0.
 */

#define RP1_I2C0_BASE_OFFSET  0x0000u

/* (We can add I2C1..I2C6 offsets later once we reverse-map the window.) */

const struct device *rp1_pcie_i2c0_get_device(void);

#endif /* RP1_PCIE_I2C_H */
```

## src/uart_cmd.c
```c
#include <uart_cmd.h>

#include <zephyr/drivers/uart.h>
#include <zephyr/sys/printk.h>
#include <zephyr/sys/util.h>
#include <zephyr/kernel.h>
#include <zephyr/logging/log.h>
#include <ctype.h>
#include <stdarg.h>
#include <string.h>
#include <errno.h>

LOG_MODULE_REGISTER(uart_cmd, LOG_LEVEL_INF);

/* ---------- Tunables ---------- */
#define UART_CMD_LINE_MAX   96
#define UART_CMD_Q_DEPTH    8
#define UART_RX_STACK_SIZE  2048
#define UART_RX_PRIORITY    5

/* ---------- Command queue storage ---------- */
K_MSGQ_DEFINE(g_cmd_q, sizeof(uart_cmd_t), UART_CMD_Q_DEPTH, 4);

/* ---------- RX thread ---------- */
K_THREAD_STACK_DEFINE(g_rx_stack, UART_RX_STACK_SIZE);
static struct k_thread g_rx_thread;

/* ---------- local helpers ---------- */

static void uart_putc_locked(uart_cmd_ctx_t *ctx, char c)
{
	uart_poll_out(ctx->uart, (unsigned char)c);
}

static void uart_puts_locked(uart_cmd_ctx_t *ctx, const char *s)
{
	while (*s) {
		uart_putc_locked(ctx, *s++);
	}
}

void uart_cmd_printf(uart_cmd_ctx_t *ctx, const char *fmt, ...)
{
	if (!ctx || !ctx->uart) {
		return;
	}

	char buf[256];

	va_list ap;
	va_start(ap, fmt);
	vsnprintk(buf, sizeof(buf), fmt, ap);
	va_end(ap);

	k_mutex_lock(&ctx->tx_lock, K_FOREVER);
	uart_puts_locked(ctx, buf);
	uart_puts_locked(ctx, "\r\n");
	k_mutex_unlock(&ctx->tx_lock);
}

void uart_cmd_print_help(uart_cmd_ctx_t *ctx)
{
	uart_cmd_printf(ctx, "Commands:");
	uart_cmd_printf(ctx, "  help | ?                 : show this help");
	uart_cmd_printf(ctx, "  start                    : start streaming");
	uart_cmd_printf(ctx, "  stop                     : stop streaming");
	uart_cmd_printf(ctx, "  read                     : read+print one sample now");
	uart_cmd_printf(ctx, "  status                   : show current mode/mask");
	uart_cmd_printf(ctx, "  ch <c|r|g|b|w|f>          : show only one channel (c=clear,w=wide,f=flicker)");
	uart_cmd_printf(ctx, "  ch <clear|red|green|blue|wide|flicker> : same as above");
	uart_cmd_printf(ctx, "  mask <list>              : set channels, comma-separated");
	uart_cmd_printf(ctx, "                             e.g. mask c,r,g,b   or mask clear,wide");
	uart_cmd_printf(ctx, "  all                      : same as mask all");
	uart_cmd_printf(ctx, "  flicker                  : print latest flicker value (from last sample)");
	uart_cmd_printf(ctx, "");
	uart_cmd_printf(ctx, "Notes:");
	uart_cmd_printf(ctx, "  - Streaming prints only the selected mask.");
	uart_cmd_printf(ctx, "  - 'read' prints one sample even if streaming is stopped.");
}

/* Trim leading/trailing whitespace in-place */
static char *trim(char *s)
{
	while (isspace((unsigned char)*s)) s++;
	if (*s == 0) return s;

	char *end = s + strlen(s) - 1;
	while (end > s && isspace((unsigned char)*end)) end--;
	end[1] = '\0';
	return s;
}

/* Lowercase in-place */
static void tolower_str(char *s)
{
	for (; *s; s++) {
		*s = (char)tolower((unsigned char)*s);
	}
}

/* Parse single token to channel bit */
static bool token_to_chbit(const char *t, uint32_t *bit_out)
{
	if (!t || !bit_out) return false;

	if (!strcmp(t, "c") || !strcmp(t, "clear"))   { *bit_out = UART_CH_CLEAR;   return true; }
	if (!strcmp(t, "r") || !strcmp(t, "red"))     { *bit_out = UART_CH_RED;     return true; }
	if (!strcmp(t, "g") || !strcmp(t, "green"))   { *bit_out = UART_CH_GREEN;   return true; }
	if (!strcmp(t, "b") || !strcmp(t, "blue"))    { *bit_out = UART_CH_BLUE;    return true; }
	if (!strcmp(t, "w") || !strcmp(t, "wide"))    { *bit_out = UART_CH_WIDE;    return true; }
	if (!strcmp(t, "f") || !strcmp(t, "flicker")) { *bit_out = UART_CH_FLICKER; return true; }
	if (!strcmp(t, "all"))                        { *bit_out = UART_CH_ALL;     return true; }

	return false;
}

static uint32_t parse_mask_list(char *list)
{
	/* list is like "c,r,g" or "clear,wide" */
	uint32_t mask = 0;

	char *save = NULL;
	for (char *tok = strtok_r(list, ",", &save); tok; tok = strtok_r(NULL, ",", &save)) {
		tok = trim(tok);
		uint32_t bit = 0;
		if (token_to_chbit(tok, &bit)) {
			if (bit == UART_CH_ALL) {
				return UART_CH_ALL;
			}
			mask |= bit;
		}
	}

	return mask;
}

static bool parse_line_to_cmd(char *line, uart_cmd_t *out)
{
	memset(out, 0, sizeof(*out));

	line = trim(line);
	if (!*line) {
		out->type = UART_CMD_NONE;
		return false;
	}

	tolower_str(line);

	/* single word commands */
	if (!strcmp(line, "help") || !strcmp(line, "?")) {
		out->type = UART_CMD_HELP;
		return true;
	}
	if (!strcmp(line, "start")) {
		out->type = UART_CMD_START;
		return true;
	}
	if (!strcmp(line, "stop")) {
		out->type = UART_CMD_STOP;
		return true;
	}
	if (!strcmp(line, "read")) {
		out->type = UART_CMD_READ_ONCE;
		return true;
	}
	if (!strcmp(line, "status")) {
		out->type = UART_CMD_STATUS;
		return true;
	}
	if (!strcmp(line, "all")) {
		out->type = UART_CMD_SET_MASK;
		out->mask = UART_CH_ALL;
		return true;
	}
	if (!strcmp(line, "flicker")) {
		out->type = UART_CMD_PRINT_FLICKER;
		return true;
	}

	/* commands with args */
	char *save = NULL;
	char *cmd = strtok_r(line, " ", &save);
	char *arg = strtok_r(NULL, "", &save); /* rest of string */

	if (!cmd) {
		out->type = UART_CMD_NONE;
		return false;
	}

	if (!strcmp(cmd, "ch")) {
		if (!arg) {
			out->type = UART_CMD_HELP;
			return true;
		}
		arg = trim(arg);
		uint32_t bit = 0;
		if (!token_to_chbit(arg, &bit)) {
			/* invalid channel -> help */
			out->type = UART_CMD_HELP;
			return true;
		}
		out->type = UART_CMD_SET_MASK;
		out->mask = (bit == UART_CH_ALL) ? UART_CH_ALL : bit;
		return true;
	}

	if (!strcmp(cmd, "mask")) {
		if (!arg) {
			out->type = UART_CMD_HELP;
			return true;
		}
		arg = trim(arg);
		uint32_t m = parse_mask_list(arg);
		if (m == 0) {
			out->type = UART_CMD_HELP;
			return true;
		}
		out->type = UART_CMD_SET_MASK;
		out->mask = m;
		return true;
	}

	/* unknown -> help */
	out->type = UART_CMD_HELP;
	return true;
}

static void push_cmd(uart_cmd_ctx_t *ctx, const uart_cmd_t *cmd)
{
	(void)k_msgq_put(ctx->cmd_q, cmd, K_NO_WAIT);
}

/* Basic line editor over uart_poll_in */
static void rx_thread_fn(void *p1, void *p2, void *p3)
{
	ARG_UNUSED(p2);
	ARG_UNUSED(p3);

	uart_cmd_ctx_t *ctx = (uart_cmd_ctx_t *)p1;
	char line[UART_CMD_LINE_MAX];
	size_t n = 0;

	/* Prompt */
	uart_cmd_printf(ctx, "UART CLI ready. Type 'help'.");

	while (1) {
		unsigned char c;
		int rc = uart_poll_in(ctx->uart, &c);
		if (rc != 0) {
			k_msleep(5);
			continue;
		}

		/* handle CR/LF */
		if (c == '\r' || c == '\n') {
			/* echo newline */
			k_mutex_lock(&ctx->tx_lock, K_FOREVER);
			uart_puts_locked(ctx, "\r\n");
			k_mutex_unlock(&ctx->tx_lock);

			line[n] = '\0';

			uart_cmd_t cmd;
			if (parse_line_to_cmd(line, &cmd) && cmd.type != UART_CMD_NONE) {
				push_cmd(ctx, &cmd);
			}

			n = 0;
			continue;
		}

		/* backspace */
		if (c == 0x08 || c == 0x7F) {
			if (n > 0) {
				n--;
				/* erase from terminal: "\b \b" */
				k_mutex_lock(&ctx->tx_lock, K_FOREVER);
				uart_puts_locked(ctx, "\b \b");
				k_mutex_unlock(&ctx->tx_lock);
			}
			continue;
		}

		/* printable */
		if (isprint(c)) {
			if (n < (sizeof(line) - 1)) {
				line[n++] = (char)c;
				/* echo */
				k_mutex_lock(&ctx->tx_lock, K_FOREVER);
				uart_putc_locked(ctx, (char)c);
				k_mutex_unlock(&ctx->tx_lock);
			} else {
				/* line overflow -> reset */
				n = 0;
				uart_cmd_printf(ctx, "Line too long. Cleared.");
			}
		}
	}
}

int uart_cmd_init(uart_cmd_ctx_t *ctx, const struct device *uart_dev)
{
	if (!ctx || !uart_dev) return -EINVAL;
	if (!device_is_ready(uart_dev)) return -ENODEV;

	memset(ctx, 0, sizeof(*ctx));
	ctx->uart = uart_dev;
	ctx->cmd_q = &g_cmd_q;
	k_mutex_init(&ctx->tx_lock);

	k_thread_create(&g_rx_thread, g_rx_stack, K_THREAD_STACK_SIZEOF(g_rx_stack),
			rx_thread_fn, ctx, NULL, NULL,
			UART_RX_PRIORITY, 0, K_NO_WAIT);

	k_thread_name_set(&g_rx_thread, "uart_cmd_rx");
	return 0;
}

int uart_cmd_get(uart_cmd_ctx_t *ctx, uart_cmd_t *out, k_timeout_t timeout)
{
	if (!ctx || !out) return -EINVAL;

	int rc = k_msgq_get(ctx->cmd_q, out, timeout);
	if (rc == 0) return 0;

	/* If non-blocking and empty, Zephyr returns -EAGAIN typically */
	return rc;
}
```
